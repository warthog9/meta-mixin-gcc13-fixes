## conf/layer.conf
```bitbake
# We have a conf and classes directory, add to BBPATH
BBPATH .= ":${LAYERDIR}"

# We have recipes-* directories, add to BBFILES
BBFILES += " \
            ${LAYERDIR}/classes/*.bbclass \
            ${LAYERDIR}/recipes-*/*/*.bb \
            ${LAYERDIR}/recipes-*/*.bb \
            ${LAYERDIR}/recipes-*/*/*.bbappend \
            ${LAYERDIR}/recipes-*/*.bbappend \
            "

BBFILE_COLLECTIONS:append = " meta-mixin-gcc13-fixes "
BBFILE_PATTERN_meta-mixin-gcc13-fixes = "^${LAYERDIR}/"
BBFILE_PRIORITY_meta-mixin-gcc13-fixes = "6"
LAYERVERSION_meta-mixin-gcc13-fixes = "1"
LAYERSERIES_COMPAT_meta-mixin-gcc13-fixes = "kirkstone"
```
